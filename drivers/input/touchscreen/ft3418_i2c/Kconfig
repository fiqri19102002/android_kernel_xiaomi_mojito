## drivers/input/touchscreen/ft3418_i2c/Kconfig
```kconfig
#
# Focaltech Touchscreen driver configuration
#

config TOUCHSCREEN_FT3418_I2C
    bool "Focaltech Touchscreen for mojito"
    depends on DRM
    default y
    help
      Say Y here if you have Focaltech touch panel.
      If unsure, say N.
      
config TOUCHSCREEN_FT3418_I2C_DIRECTORY
    string "Focaltech ts directory name"
    default "focaltech_touch_ft3418_i2c"
    depends on TOUCHSCREEN_FT3418_I2C
    
```

## drivers/platform/Kconfig
```kconfig
if X86
source "drivers/platform/x86/Kconfig"
endif
if MIPS
source "drivers/platform/mips/Kconfig"
endif

source "drivers/platform/goldfish/Kconfig"

source "drivers/platform/chrome/Kconfig"

source "drivers/platform/msm/Kconfig"

if ARCH_SM6150
source "drivers/platform/mojito/Kconfig"
endif
```

## drivers/platform/mojito/Kconfig
```kconfig
config MACH_XIAOMI_MOJITO
	bool "Xiaomi Redmi Note 10"
	depends on ARCH_SM6150
	help
	  Support for Xiaomi Redmi Note 10.
```
